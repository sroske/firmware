#include "p33exxxx.h"
#include "spintronics.h"

/*
 * contents of the array defined as follows:
 * cosLUT[i] =  (int16_t)(cos(pi * (_Q15)(i + 1) * 32768)
 *  */

#ifdef TRIG_USES_LUT
__prog__ _Q15 __attribute__((space(prog)))
cosLUT_ZeroToPiByTwo[0x3FFFu] = {32767, 32767, 32767, 32767, 32767, 32767, 32767, 32767, 32767, 32767, 32767, 32767, 32767,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 6, 3};

_Q15 _Q15cosPILUT(uint16_t phiOverPI)
{
    switch(phiOverPI)
    {
        case 0x0000: return 0x7FFF;
        case 0x4000:
        case 0xC000: return 0x0000;
        case 0x8000: return 0x8000;
        default:
        {
            if (phiOverPI > 0xC000)
            {
                return cosLUT_ZeroToPiByTwo[-phiOverPI - 1];
            }
            if (phiOverPI > 0x8000)
            {
                return -cosLUT_ZeroToPiByTwo[phiOverPI - 0x8000 - 1];
            }
            if (phiOverPI > 0x4000)
            {
                return -cosLUT_ZeroToPiByTwo[0x8000 - phiOverPI - 1];
            }
            return cosLUT_ZeroToPiByTwo[phiOverPI - 1];
        }

    }
}

_Q15 _Q15sinPILUT(uint16_t phiOverPI)
{
    switch(phiOverPI)
    {
        case 0x4000: return 0x7FFF;
        case 0x0000:
        case 0x8000: return 0x0000;
        case 0xC000: return 0x8000;
        default:
        {
            if (phiOverPI > 0xC000)
            {
                return -cosLUT_ZeroToPiByTwo[phiOverPI - 0xC000 - 1];
            }
            if (phiOverPI > 0x8000)
            {
                return -cosLUT_ZeroToPiByTwo[0xC000 - phiOverPI - 1];
            }
            if (phiOverPI > 0x4000)
            {
                return cosLUT_ZeroToPiByTwo[phiOverPI - 0x4000 - 1];
            }
            return cosLUT_ZeroToPiByTwo[0x4000 - phiOverPI - 1];
        }

    }
}
#endif
